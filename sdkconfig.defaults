## sdkconfig.defaults
```kconfig
CONFIG_FREERTOS_HZ=1000

CONFIG_ARDUINO_SELECTIVE_COMPILATION=n
CONFIG_ARDUINO_WIFI_ENABLED=y
CONFIG_ARDUINO_DNSSERVER_ENABLED=y
CONFIG_ARDUINO_HTTPCLIENT_ENABLED=y
CONFIG_ARDUINO_HTTPUPDATE_ENABLED=y
CONFIG_ARDUINO_UPDATE_ENABLED=y
CONFIG_ARDUINO_BASE64_ENABLED=y
```
